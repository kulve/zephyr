## boards/arm/nucleo_l053r8/Kconfig.defconfig
```kconfig
# Kconfig - STM32 Nucleo-64 development board with STM32L053R8 MCU
#
# Copyright (c) 2018 Ilya Tagunov <tagunil@gmail.com>
# Copyright (c) 2018 Tuomas Kulve <tuomas@kulve.fi>
#
# SPDX-License-Identifier: Apache-2.0
#

if BOARD_NUCLEO_L053R8

config BOARD
	default nucleo_l053r8

if UART_CONSOLE

config UART_STM32_PORT_2
	default y

endif # UART_CONSOLE

if I2C

config I2C_1
	default y

endif # I2C

if SPI

config SPI_1
	default y

config SPI_STM32_INTERRUPT
	default y

endif # SPI

endif # BOARD_NUCLEO_L053R8
```
